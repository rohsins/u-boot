## board/rts/Kconfig
```kconfig
if TARGET_RTS

config SYS_BOARD
	default "rts"

config SYS_CONFIG_NAME
	default "rts"

endif
```

## board/rts/logger/Kconfig
```kconfig
if TARGET_RTS_LOGGER

config SYS_VENDOR
	default "rts"

config SYS_BOARD
	default "logger"

config SYS_CONFIG_NAME
	default "rts_logger"

endif
```
